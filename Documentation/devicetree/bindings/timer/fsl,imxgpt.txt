## Documentation/devicetree/bindings/timer/fsl,imxgpt.txt
```
Freescale i.MX General Purpose Timer (GPT)

Required properties:

- compatible : should be one of following:
  for i.MX1:
  - "fsl,imx1-gpt";
  for i.MX21:
  - "fsl,imx21-gpt";
  for i.MX27:
  - "fsl,imx27-gpt", "fsl,imx21-gpt";
  for i.MX31:
  - "fsl,imx31-gpt";
  for i.MX25:
  - "fsl,imx25-gpt", "fsl,imx31-gpt";
  for i.MX50:
  - "fsl,imx50-gpt", "fsl,imx31-gpt";
  for i.MX51:
  - "fsl,imx51-gpt", "fsl,imx31-gpt";
  for i.MX53:
  - "fsl,imx53-gpt", "fsl,imx31-gpt";
  for i.MX6Q:
  - "fsl,imx6q-gpt", "fsl,imx31-gpt";
  for i.MX6DL:
  - "fsl,imx6dl-gpt";
  for i.MX6SL:
  - "fsl,imx6sl-gpt", "fsl,imx6dl-gpt";
  for i.MX6SX:
  - "fsl,imx6sx-gpt", "fsl,imx6dl-gpt";
- reg : specifies base physical address and size of the registers.
- interrupts : should be the gpt interrupt.
- clocks : the clocks provided by the SoC to drive the timer, must contain
           an entry for each entry in clock-names.
- clock-names : must include "ipg" entry first, then "per" entry.

Optional properties:

- pinctrl-0: For the i.MX GPT to support the Input Capture function,
  	     the input capture channel pin groups must be listed here.
- pinctrl-names: must be "default".


Example:

gpt1: timer@10003000 {
	compatible = "fsl,imx27-gpt", "fsl,imx21-gpt";
	reg = <0x10003000 0x1000>;
	interrupts = <26>;
	clocks = <&clks IMX27_CLK_GPT1_IPG_GATE>,
		 <&clks IMX27_CLK_PER1_GATE>;
	clock-names = "ipg", "per";
};


Example with input capture channel 0 support:

pinctrl_gpt_input_capture0: gptinputcapture0grp {
	fsl,pins = <
		MX6QDL_PAD_SD1_DAT0__GPT_CAPTURE1 0x1b0b0
	>;
};

gpt: gpt@2098000 {
	compatible = "fsl,imx6q-gpt", "fsl,imx31-gpt";
	reg = <0x02098000 0x4000>;
	interrupts = <0 55 IRQ_TYPE_LEVEL_HIGH>;
	clocks = <&clks IMX6QDL_CLK_GPT_IPG>,
		<&clks IMX6QDL_CLK_GPT_IPG_PER>,
		<&clks IMX6QDL_CLK_GPT_3M>;
	clock-names = "ipg", "per", "osc_per";
	pinctrl-names = "default";
	pinctrl-0 = <&pinctrl_gpt_input_capture0>;
};
```
